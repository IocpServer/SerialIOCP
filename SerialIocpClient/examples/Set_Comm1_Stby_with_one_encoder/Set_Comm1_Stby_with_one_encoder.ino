/*
*	IocpServer Example
*   Change COM1 STBY FRQ with a Rotary Encoder Tutorial
*
*	by Juan R. Ascanio *
*
*	IMPORTANT NOTE:
*	WITH THIS SAMPLE YOU CAN CHANGE THE COMM1 STBY FREQUENCY IN JUMPS OF 10Khz, NOT 25Khz AS PLANE DOES.
*	YOU NEED TO MAKE CHANGES ON THE CODE TO MAKE EACH 'JUMP' OF 25Khz
*
*/

#include <SerialIocpClient.h>

/////////////////////////////////////////////////
// OFFSETS DEFINITION GENERATED BY SerialIocp
/////////////////////////////////////////////////
#define COM_FREQUENCY   21 // Codification bcd16
#define COM_STBY_FREQUENCY  615 // Codification bcd16

// DEFINE PINS USED BY THE ENCODER
#define ENCODER_CLK 10			// CLK PIN ON ENCODER
#define ENCODER_DT	11			// DT  PIN ON ENCODER
#define ENCODER_SW	12		// SW  PIN ON ENCODER

//////////////////////////////////////////////////////////////////////////////////////////////
// OnIocpCommand called by Iocp Librarie, as declared as callback on SetUp function, when a
// command is recieved:
// Params: 
//    int nCommand, can be:
//      COMMAND_READY: When SerialIocp on the PC is connected to the Simulator
//      COMMAND_QUIT:  When SerialIocp on the PC is dis-connected from the Simulator
//////////////////////////////////////////////////////////////////////////////////////////////
void OnIocpCommand(int nCommand)
{
	switch (nCommand)
	{
	case COMMAND_READY:
	{
		// Code executed When SerialIocp on the PC is connected to the Simulator
		break;
	}
	case COMMAND_QUIT:
	{
		// Code executed When SerialIocp on the PC is dis-connected from the Simulator
		break;
	}
	}
}


// Global variables to be used
int Com1_Stby = 0;
int Com1_Frq = 0;
int aState = 0;
int aLastState = 0;
bool toggle = true;

//////////////////////////////////////////////////////////////////////////////////////////////
// OnIocpValue called by Iocp Librarie, as declared as callback on SetUp function,
// when any offset valus is changed on the Simulator recieved:
// Params: 
//    long nId, is the offset ID, to compare with the #define generated by SerialIocp or with 
//              the OffSet ID numbre.
//    long nVal, is the new value that OFFSET nId has in the Simulator.
//////////////////////////////////////////////////////////////////////////////////////////////
void OnIocpValue(long nId, long nVal)
{
	// Each time any Registered Offset Value has changed on the Simulator, the IocpSerial libarie call this function.
	if (nId == COM_STBY_FREQUENCY)
		Com1_Stby = nVal;
	if (nId == COM_FREQUENCY)
		Com1_Frq = nVal;
}

/////////////////////////////////////////////////////////////////////////////////////////////
// Standard Arduino setup() function
/////////////////////////////////////////////////////////////////////////////////////////////
void setup()
{
	// Initialize pins used by encoder 
	pinMode(ENCODER_CLK, INPUT);
	pinMode(ENCODER_DT, INPUT);
	pinMode(ENCODER_SW, INPUT_PULLUP);

	// Iocp Initialize
	iocp.Open(2000000);
	iocp.SetOnCommand(&OnIocpCommand);
	iocp.SetOnValue(&OnIocpValue);

	// Get initial state of the pin CLK
	aLastState = digitalRead(ENCODER_CLK);
}

/////////////////////////////////////////////////////////////////////////////////////////////
// Standard Arduino loop() function
/////////////////////////////////////////////////////////////////////////////////////////////
void loop()
{
	// Get current state of CLK pin
	aState = digitalRead(ENCODER_CLK);
	// If lastState is diferent of current state, and currenmt state is active...
	if (aState && aState != aLastState)
	{
		// If the DT state is not active, that means the encoder is rotating clockwise
		if (digitalRead(ENCODER_DT) != aState)
		{
			Com1_Stby--;
			iocp.SetOffset(COM_STBY_FREQUENCY, Com1_Stby);
		}
		// Otherwise, is rotating anti-clockwise
		else
		{
			Com1_Stby++;
			iocp.SetOffset(COM_STBY_FREQUENCY, Com1_Stby);
		}
	}
	// Remember current state for next loop
	aLastState = aState;

	if (!digitalRead(ENCODER_SW))
	{
		if (toggle)
		{
			iocp.SetOffset(COM_FREQUENCY, Com1_Stby);
			iocp.SetOffset(COM_STBY_FREQUENCY, Com1_Frq);
			delay(300);
			toggle = false;
		}
	}
	else
		toggle = true;
}