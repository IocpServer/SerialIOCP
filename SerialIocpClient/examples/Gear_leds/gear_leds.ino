/*
*	IocpServer Example
*   See gear Lights using LEDS
*
*	by Juan R. Ascanio *
*
*/

#include <SerialIocpClient.h>

/////////////////////////////////////////////////
// OFFSETS DEFINITION GENERATED BY SerialIocp
/////////////////////////////////////////////////
#define GEAR_POS_NOSE   330 // Codification none
#define GEAR_POS_LEFT   331 // Codification none
#define GEAR_POS_RIGHT  332 // Codification none

// DEFINE PINS USED BY LEDS
#define RIGHT_RED   2 
#define RIGHT_GREEN 3  
#define NOSE_RED    4 
#define NOSE_GREEN  5 
#define LEFT_RED    6 
#define LEFT_GREEN  7 

//////////////////////////////////////////////////////////////////////////////////////////////
// OnIocpCommand called by Iocp Librarie, as declared as callback on SetUp function, when a
// command is recieved:
// Params: 
//    int nCommand, can be:
//      COMMAND_READY: When SerialIocp on the PC is connected to the Simulator
//      COMMAND_QUIT:  When SerialIocp on the PC is dis-connected from the Simulator
//////////////////////////////////////////////////////////////////////////////////////////////
void OnIocpCommand(int nCommand)
{
	switch (nCommand)
	{
	case COMMAND_READY:
	{
		// Code executed When SerialIocp on the PC is connected to the Simulator
		break;
	}
	case COMMAND_QUIT:
	{
		// Code executed When SerialIocp on the PC is dis-connected from the Simulator
		digitalWrite(NOSE_RED, LOW);
		digitalWrite(NOSE_GREEN, LOW);
		digitalWrite(LEFT_RED, LOW);
		digitalWrite(LEFT_GREEN, LOW);
		digitalWrite(RIGHT_RED, LOW);
		digitalWrite(RIGHT_GREEN, LOW);
		break;
	}
	}
}


// Global variables to be used

//////////////////////////////////////////////////////////////////////////////////////////////
// OnIocpValue called by Iocp Librarie, as declared as callback on SetUp function,
// when any offset valus is changed on the Simulator recieved:
// Params: 
//    long nId, is the offset ID, to compare with the #define generated by SerialIocp or with 
//              the OffSet ID numbre.
//    long nVal, is the new value that OFFSET nId has in the Simulator.
//////////////////////////////////////////////////////////////////////////////////////////////
void OnIocpValue(long nId, long nVal)
{
	// Each time any Registered Offset Value has changed on the Simulator, the IocpSerial libarie call this function.
	switch (nId)
	{
	case GEAR_POS_NOSE:
	{
		if (nVal == 0)
		{
			digitalWrite(NOSE_RED, LOW);
			digitalWrite(NOSE_GREEN, LOW);
		}
		else
			if (nVal == 16383)
			{
				digitalWrite(NOSE_RED, LOW);
				digitalWrite(NOSE_GREEN, HIGH);
			}
			else
			{
				digitalWrite(NOSE_RED, HIGH);
				digitalWrite(NOSE_GREEN, LOW);
			}
		break;
	}
	case GEAR_POS_LEFT:
	{
		if (nVal == 0)
		{
			digitalWrite(LEFT_RED, LOW);
			digitalWrite(LEFT_GREEN, LOW);
		}
		else
			if (nVal == 16383)
			{
				digitalWrite(LEFT_RED, LOW);
				digitalWrite(LEFT_GREEN, HIGH);
			}
			else
			{
				digitalWrite(LEFT_RED, HIGH);
				digitalWrite(LEFT_GREEN, LOW);
			}
		break;
	}
	case GEAR_POS_RIGHT:
	{
		if (nVal == 0)
		{
			digitalWrite(RIGHT_RED, LOW);
			digitalWrite(RIGHT_GREEN, LOW);
		}
		else
			if (nVal == 16383)
			{
				digitalWrite(RIGHT_RED, LOW);
				digitalWrite(RIGHT_GREEN, HIGH);
			}
			else
			{
				digitalWrite(RIGHT_RED, HIGH);
				digitalWrite(RIGHT_GREEN, LOW);
			}
		break;
	}
	}
}

/////////////////////////////////////////////////////////////////////////////////////////////
// Standard Arduino setup() function
/////////////////////////////////////////////////////////////////////////////////////////////
void setup()
{
	// Initialize pins used by encoder
	pinMode(NOSE_RED, OUTPUT);
	pinMode(NOSE_GREEN, OUTPUT);
	pinMode(LEFT_RED, OUTPUT);
	pinMode(LEFT_GREEN, OUTPUT);
	pinMode(RIGHT_RED, OUTPUT);
	pinMode(RIGHT_GREEN, OUTPUT);

	digitalWrite(NOSE_RED, LOW);
	digitalWrite(NOSE_GREEN, LOW);
	digitalWrite(LEFT_RED, LOW);
	digitalWrite(LEFT_GREEN, LOW);
	digitalWrite(RIGHT_RED, LOW);
	digitalWrite(RIGHT_GREEN, LOW);


	// Iocp Initialize
	iocp.Open(2000000);
	iocp.SetOnCommand(&OnIocpCommand);
	iocp.SetOnValue(&OnIocpValue);
}

/////////////////////////////////////////////////////////////////////////////////////////////
// Standard Arduino loop() function
/////////////////////////////////////////////////////////////////////////////////////////////
void loop()
{
	delay(50);
}